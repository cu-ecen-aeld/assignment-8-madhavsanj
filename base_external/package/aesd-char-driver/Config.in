## base_external/package/aesd-char-driver/Config.in
```kconfig
config BR2_PACKAGE_AESD_CHAR_DRIVER
    bool "aesd-char-driver"
    help
      Build and install the aesd char driver kernel module
      from the assignments-3-and-later repository.
```
